## components/i2c/Kconfig.projbuild
```kconfig
menu "Touch FT6X36 Configuration"
    comment "The touch chip needs an I2C port and one input GPIO"
# This should be shared between RTC & Touch
    config TOUCH_SDA
        int "I2C data SDA"
        range 0 35
        default 5
    config TOUCH_SDL
        int "I2C clock SDL"
        range 0 37
        default 4
    config TOUCH_INT
        int "Touch interrupt: On LOW reads the data via I2C (Input pullup)"
        range -1 34
        default 8
    config I2C_MASTER_FREQUENCY
        int "I2C Frequency"
        range 50000 500000

    config FT6X36_DEBUG
        int "FT6X36 debug: On 1 will output FocalTech touch events via serial"
        range 0 1
        default 1
    config FT6X36_DEBUG_EVENTS
        int "FT6X36 debug events: On 1 will output touch events only"
        range 0 1
        default 0
endmenu
```
